## configs/buildroot/nano_qemu_aarch64_defconfig
```kconfig
# NanoOS QEMU aarch64 Defconfig
# Target architecture
BR2_aarch64=y

# Toolchain
BR2_TOOLCHAIN_BUILDROOT_GLIBC=y
BR2_TOOLCHAIN_BUILDROOT_CXX=y

# Hostname and credentials
BR2_TARGET_GENERIC_HOSTNAME="nano-os"
BR2_TARGET_GENERIC_ISSUE="Welcome to NanoOS"
BR2_TARGET_GENERIC_ROOT_PASSWD="nano"

# Init system
BR2_INIT_SYSTEMD=y

# Kernel
BR2_LINUX_KERNEL=y
BR2_LINUX_KERNEL_USE_DEFCONFIG=y
BR2_LINUX_KERNEL_DEFCONFIG="defconfig"
BR2_LINUX_KERNEL_IMAGE_TARGET_CUSTOM=y
BR2_LINUX_KERNEL_IMAGE_TARGET_NAME="Image"
BR2_LINUX_KERNEL_CONFIG_FRAGMENT_FILES="$(TOPDIR)/../configs/kernel/fragments/base.config $(TOPDIR)/../configs/kernel/fragments/mobile.config $(TOPDIR)/../configs/kernel/fragments/wayland.config"
BR2_LINUX_KERNEL_NEEDS_HOST_OPENSSL=y

# Root filesystem
BR2_TARGET_ROOTFS_EXT2=y
BR2_TARGET_ROOTFS_EXT2_4=y
BR2_TARGET_ROOTFS_EXT2_SIZE="1G"

# Rootfs overlay and post-build
BR2_ROOTFS_OVERLAY="$(TOPDIR)/../overlays/rootfs"
BR2_ROOTFS_POST_BUILD_SCRIPT="$(TOPDIR)/../scripts/post-build.sh"

# System packages
BR2_PACKAGE_SYSTEMD=y
BR2_PACKAGE_SYSTEMD_LOGIND=y
BR2_PACKAGE_SYSTEMD_NETWORKD=y
BR2_PACKAGE_SYSTEMD_RESOLVED=y
BR2_PACKAGE_SYSTEMD_TMPFILES=y
BR2_PACKAGE_SYSTEMD_HWDB=y
BR2_PACKAGE_SYSTEMD_BACKLIGHT=y
BR2_PACKAGE_UTIL_LINUX=y
BR2_PACKAGE_UTIL_LINUX_AGETTY=y
BR2_PACKAGE_BASH=y
BR2_PACKAGE_DBUS=y
# Note: systemd provides udev; eudev conflicts with systemd

# Graphics: Mesa3D with virgl
BR2_PACKAGE_MESA3D=y
BR2_PACKAGE_MESA3D_GALLIUM_DRIVER_VIRGL=y
BR2_PACKAGE_MESA3D_OPENGL_EGL=y
BR2_PACKAGE_MESA3D_OPENGL_ES=y
BR2_PACKAGE_MESA3D_GBM=y
BR2_PACKAGE_LIBDRM=y

# Wayland
BR2_PACKAGE_WAYLAND=y
BR2_PACKAGE_WAYLAND_PROTOCOLS=y

# Input
BR2_PACKAGE_LIBINPUT=y
BR2_PACKAGE_LIBXKBCOMMON=y
BR2_PACKAGE_LIBEVDEV=y

# Compositors
BR2_PACKAGE_WLROOTS=y

# Terminal
BR2_PACKAGE_FOOT=y

# GTK3 (GTK4 may not be available in all Buildroot versions)
BR2_PACKAGE_LIBGTK3=y
BR2_PACKAGE_LIBGTK3_WAYLAND=y

# Graphics libraries
BR2_PACKAGE_PIXMAN=y
BR2_PACKAGE_CAIRO=y
BR2_PACKAGE_PANGO=y
BR2_PACKAGE_LIBGLIB2=y
BR2_PACKAGE_JSON_GLIB=y

# Font rendering
BR2_PACKAGE_FREETYPE=y
BR2_PACKAGE_FONTCONFIG=y
BR2_PACKAGE_LIBERATION=y

# Audio: PipeWire stack
BR2_PACKAGE_PIPEWIRE=y
BR2_PACKAGE_PIPEWIRE_GSTREAMER=y
BR2_PACKAGE_ALSA_LIB=y
BR2_PACKAGE_ALSA_UTILS=y

# Networking
BR2_PACKAGE_OPENSSH=y
BR2_PACKAGE_GLIB_NETWORKING=y
BR2_PACKAGE_IWD=y
BR2_PACKAGE_WIRELESS_TOOLS=y

# Utilities
BR2_PACKAGE_HTOP=y
BR2_PACKAGE_NANO=y
BR2_PACKAGE_IPROUTE2=y

# NanoOS custom packages (BR2_EXTERNAL)
BR2_PACKAGE_NANO_COMPOSITOR=y
BR2_PACKAGE_NANO_SHELL=y
BR2_PACKAGE_NANO_SETTINGS=y
BR2_PACKAGE_NANO_NOTIF=y
BR2_PACKAGE_NANO_POWER=y
BR2_PACKAGE_NANO_NET=y
BR2_PACKAGE_NANO_CLOCK=y
BR2_PACKAGE_NANO_CALCULATOR=y
BR2_PACKAGE_NANO_NOTES=y
BR2_PACKAGE_NANO_DEVICE=y
```

## external/Config.in
```kconfig
source "$BR2_EXTERNAL_NANO_PATH/package/nano-compositor/Config.in"
source "$BR2_EXTERNAL_NANO_PATH/package/nano-shell/Config.in"
source "$BR2_EXTERNAL_NANO_PATH/package/nano-settings/Config.in"
source "$BR2_EXTERNAL_NANO_PATH/package/nano-notif/Config.in"
source "$BR2_EXTERNAL_NANO_PATH/package/nano-power/Config.in"
source "$BR2_EXTERNAL_NANO_PATH/package/nano-net/Config.in"
source "$BR2_EXTERNAL_NANO_PATH/package/nano-clock/Config.in"
source "$BR2_EXTERNAL_NANO_PATH/package/nano-calculator/Config.in"
source "$BR2_EXTERNAL_NANO_PATH/package/nano-notes/Config.in"
source "$BR2_EXTERNAL_NANO_PATH/package/nano-device/Config.in"
```

## external/package/nano-calculator/Config.in
```kconfig
config BR2_PACKAGE_NANO_CALCULATOR
	bool "nano-calculator"
	depends on BR2_PACKAGE_LIBGTK3
	depends on BR2_PACKAGE_WAYLAND
	select BR2_PACKAGE_LIBGLIB2
	help
	  NanoOS calculator application.
	  Basic four-function calculator with touch-friendly UI.
```

## external/package/nano-clock/Config.in
```kconfig
config BR2_PACKAGE_NANO_CLOCK
	bool "nano-clock"
	depends on BR2_PACKAGE_LIBGTK3
	depends on BR2_PACKAGE_WAYLAND
	select BR2_PACKAGE_LIBGLIB2
	help
	  NanoOS clock application.
	  Features clock, stopwatch, and timer.
```

## external/package/nano-compositor/Config.in
```kconfig
config BR2_PACKAGE_NANO_COMPOSITOR
	bool "nano-compositor"
	depends on BR2_PACKAGE_WLROOTS
	depends on BR2_PACKAGE_WAYLAND
	depends on BR2_PACKAGE_LIBINPUT
	depends on BR2_PACKAGE_LIBXKBCOMMON
	select BR2_PACKAGE_LIBDRM
	select BR2_PACKAGE_MESA3D
	help
	  NanoOS Wayland compositor based on wlroots.
	  Provides the graphical display server for NanoOS.
```

## external/package/nano-device/Config.in
```kconfig
config BR2_PACKAGE_NANO_DEVICE
	bool "nano-device"
	select BR2_PACKAGE_LIBGLIB2
	select BR2_PACKAGE_DBUS
	help
	  NanoOS device abstraction daemon.
	  Provides D-Bus interfaces for backlight, LED, haptic,
	  orientation, and sensor access.
```

## external/package/nano-net/Config.in
```kconfig
config BR2_PACKAGE_NANO_NET
	bool "nano-net"
	depends on BR2_PACKAGE_DBUS
	select BR2_PACKAGE_LIBGLIB2
	help
	  NanoOS network status service.
	  Monitors network interfaces and reports status via D-Bus.
```

## external/package/nano-notes/Config.in
```kconfig
config BR2_PACKAGE_NANO_NOTES
	bool "nano-notes"
	depends on BR2_PACKAGE_LIBGTK3
	depends on BR2_PACKAGE_WAYLAND
	select BR2_PACKAGE_LIBGLIB2
	help
	  NanoOS notes application.
	  Simple note-taking app with file-backed storage.
```

## external/package/nano-notif/Config.in
```kconfig
config BR2_PACKAGE_NANO_NOTIF
	bool "nano-notif"
	depends on BR2_PACKAGE_DBUS
	select BR2_PACKAGE_LIBGLIB2
	help
	  NanoOS notification daemon.
	  Implements org.freedesktop.Notifications and org.nano.Notifications
	  D-Bus interfaces.
```

## external/package/nano-power/Config.in
```kconfig
config BR2_PACKAGE_NANO_POWER
	bool "nano-power"
	depends on BR2_PACKAGE_DBUS
	select BR2_PACKAGE_LIBGLIB2
	help
	  NanoOS power management service.
	  Monitors battery status and handles power events via D-Bus.
```

## external/package/nano-settings/Config.in
```kconfig
config BR2_PACKAGE_NANO_SETTINGS
	bool "nano-settings"
	depends on BR2_PACKAGE_DBUS
	select BR2_PACKAGE_LIBGLIB2
	select BR2_PACKAGE_JSON_GLIB
	help
	  NanoOS settings daemon.
	  Provides D-Bus interface for system settings management.
```

## external/package/nano-shell/Config.in
```kconfig
config BR2_PACKAGE_NANO_SHELL
	bool "nano-shell"
	depends on BR2_PACKAGE_LIBGTK3
	depends on BR2_PACKAGE_WAYLAND
	select BR2_PACKAGE_LIBGLIB2
	select BR2_PACKAGE_JSON_GLIB
	select BR2_PACKAGE_CAIRO
	select BR2_PACKAGE_PANGO
	help
	  NanoOS mobile shell UI.
	  Provides the home screen, app launcher, and system panels.
```
